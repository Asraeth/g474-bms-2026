/* Additional P1 regressions; keep the existing 37-group and 20-scenario suites.
 * Golden files are generated by compiling the exact pre-change wrapper. */
#define BMS_VIRTUAL_BENCH_NO_MAIN
#include "virtual_bms_bench.c"

static uint32_t float_bits(float value)
{
    uint32_t bits; memcpy(&bits, &value, sizeof bits); return bits;
}

static void sample_values(uint32_t bits, float values[4])
{
    int32_t signed_code = bits <= INT16_MAX ? (int32_t)bits : (int32_t)bits - 65536;
    int16_t raw = (int16_t)signed_code;
    uint8_t data[TOTAL_IC][DATA_LEN] = {{0}};
    // GNU11 needs an explicit array-pointer qualification conversion.
    const uint8_t (*read_data)[DATA_LEN] = (const uint8_t (*)[DATA_LEN])data;
    static float parsed[TOTAL_AD68][TOTAL_CELL];
    put_word(data[0], 0, raw);
    bms_parseVoltage(read_data, parsed, 0);
    values[0] = parsed[0][0];
    put_word(data[0], 2, raw);
    bms_parseAuxVoltage(read_data, 4);
    values[1] = pendingAux.temp_ic[0];
    put_word(data[0], 4, raw);
    bms_parseAuxVoltage(read_data, 3);
    values[2] = pendingAux.v_segment[0];
    // Finite legacy inputs exercise both original sentinels and interpolation.
    values[3] = convertCellTemp((float)raw * 0.0001f + 1.8f);
}

static void numeric_golden(const char *path, bool write)
{
    FILE *file = fopen(path, write ? "wb" : "rb"); assert(file);
    for (uint32_t bits = 0; bits <= UINT16_MAX; bits++) {
        float actual[4]; sample_values(bits, actual);
        if (write) assert(fwrite(actual, sizeof actual, 1, file) == 1);
        else {
            float expected[4]; assert(fread(expected, sizeof expected, 1, file) == 1);
            for (unsigned int kind = 0; kind < 4; kind++)
                assert(float_bits(actual[kind]) == float_bits(expected[kind]));
        }
    }
    if (!write) assert(fgetc(file) == EOF);
    fclose(file);
    puts(write ? "BASELINE 262144 golden results written" :
        "PASS bitwise identity to original wrapper: all 65536 signed ADC codes for cell/die/VPV plus 65536 finite legacy conversions");
}

static void test_protection_boundaries(void)
{
    float values[4];
    sample_values(12000, values); assert(values[0] == BMS_MV_TO_V(BMS_CELL_UV_MV));
    sample_values(18000, values); assert(values[0] == BMS_MV_TO_V(BMS_CELL_OV_MV));
    sample_values(3650, values); assert(values[1] == BMS_DIE_TEMP_MIN_C);
    sample_values(7150, values); assert(values[1] == BMS_DIE_TEMP_MAX_C);
    sample_values((uint16_t)-3600, values); assert(values[2] == BMS_MV_TO_V(BMS_BOARD_UV_MV));
    sample_values((uint16_t)-1040, values); assert(values[2] == BMS_MV_TO_V(BMS_BOARD_OV_MV));
    sample_values((uint16_t)INT16_MIN, values); assert(isnan(values[0]) && isnan(values[1]) && isnan(values[2]));
    sample_values(INT16_MAX, values); assert(isnan(values[1]));
    puts("PASS raw-code inclusive cell/die/board limits and reset-code invalidation");
}

static void capture(uint32_t period, uint32_t high)
{
    virtual_capture_period = period; virtual_capture_high = high;
    virtual_isr = true; HAL_TIM_IC_CaptureCallback(&htim15); virtual_isr = false;
}

static void test_imd_deferral(void)
{
    const uint32_t vectors[][2] = {
        {1280000,640000}, {1280000,0}, {1280000,1280000}, {1,UINT32_MAX},
        {UINT32_MAX,UINT32_MAX}, {UINT32_MAX,1}, {UINT32_MAX,0}, {3,2}, {7,1}, {100,33},
    };
    for (unsigned int i = 0; i < sizeof vectors / sizeof vectors[0]; i++) {
        ImdStatus previous = imdStatus;
        capture(vectors[i][0], vectors[i][1]);
        assert(imdStatus.period == previous.period && imdStatus.freq == previous.freq
            && float_bits(imdStatus.duty) == float_bits(previous.duty));
        assert(imdCapture.pending); // ISR did not perform publication/division.
        BMS_ProcessImdCapture();
        const float expected = (float)(((double)vectors[i][1] * 100.0) / (double)vectors[i][0]);
        assert(imdStatus.period == vectors[i][0] && imdStatus.freq == UINT32_C(128000000) / vectors[i][0]);
        assert(float_bits(imdStatus.duty) == float_bits(expected) && !imdCapture.pending);
        assert(virtual_mask == 0);
    }
    ImdStatus previous = imdStatus;
    capture(0, UINT32_MAX); BMS_ProcessImdCapture();
    assert(imdStatus.period == 0 && imdStatus.freq == previous.freq
        && float_bits(imdStatus.duty) == float_bits(previous.duty));
    capture(100,20); capture(200,50); BMS_ProcessImdCapture();
    assert(imdStatus.period == 200 && imdStatus.duty == 25.0f); // Latest coherent capture.
    previous = imdStatus;
    BMS_ProcessImdCapture();
    assert(imdStatus.period == previous.period && float_bits(imdStatus.duty) == float_bits(previous.duty));
    virtual_isr = true; HAL_TIM_IC_CaptureCallback(&htim16); virtual_isr = false;
    assert(!imdCapture.pending);
    capture(100,50); virtual_mask = 1; BMS_ProcessImdCapture();
    assert(virtual_mask == 1 && imdStatus.duty == 50.0f); virtual_mask = 0;
    puts("PASS deferred IMD capture, uint32 extremes, zero period, latest snapshot, unrelated timer and interrupt-mask restoration");
}

static void test_nan_guards(void)
{
    assert(isnan(convertCellTemp(NAN)));
    assert(convertCellTemp(INFINITY) == 888.0f && convertCellTemp(-INFINITY) == 888.0f);
    // Preserve the existing finite endpoint behavior, not calibration cleanup.
    assert(convertCellTemp(1.30f) == 888.0f && convertCellTemp(2.44f) == 888.0f);
    const float rejected[] = {NAN, INFINITY, -INFINITY, -1.0f, 0.0f, 1.1f};
    for (unsigned int i = 0; i < sizeof rejected / sizeof rejected[0]; i++) {
        virtual_tim3_registers.CCR2 = 12345;
        BMS_WriteFanDuty(rejected[i]);
        assert(virtual_tim3_registers.CCR2 == 12345);
    }
    BMS_WriteFanDuty(0.7f); assert(virtual_tim3_registers.CCR2 == 76);
    BMS_WriteFanDuty(1.0f); assert(virtual_tim3_registers.CCR2 == 0);
    for (unsigned int board = 0; board < TOTAL_AD68; board++)
        for (unsigned int channel = 0; channel < TOTAL_TEMP; channel++) assert(!ic_ad68.temp_valid[board][channel]);
    puts("PASS NaN remains invalid without table access; fan rejects nonfinite input without register writes; finite policy preserved");
}

int main(int argc, char **argv)
{
    if (argc != 3) return 2;
    (void)run_scenario; // This executable reuses the fixture, not its CLI scenarios.
    firmware_log = tmpfile(); assert(firmware_log);
    bool write = strcmp(argv[1], "--write-baseline") == 0;
    if (!write && strcmp(argv[1], "--verify") != 0) return 2;
    numeric_golden(argv[2], write);
    if (!write) { test_protection_boundaries(); test_imd_deferral(); test_nan_guards(); }
    fclose(firmware_log);
    return 0;
}
